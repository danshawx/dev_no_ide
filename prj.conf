## CMakeLists.txt
```
cmake_minimum_required(VERSION 3.0)
project(demo)

# include extension command file
include(${CMAKE_CURRENT_SOURCE_DIR}/cmake/extensions.cmake)
# include(${CMAKE_CURRENT_SOURCE_DIR}/cmake/exdefinition.cmake)
include(${CMAKE_CURRENT_SOURCE_DIR}/cmake/kconfig.cmake)

set(ELF ${PROJECT_NAME}.elf)

enable_language(ASM)
set(STARTUP_FILE "startup_stm32g474retx.s")

add_executable(${ELF} "")

target_sources(${ELF}
  PRIVATE
      src/main.c
      ${STARTUP_FILE}
  )

add_subdirectory(stm32g4_ll)
add_subdirectory(src/app)
add_subdirectory(src/driver)
add_subdirectory(src/kernel)
add_subdirectory(src/service)

add_subdirectory_ifdef(CONFIG_BOOTLOADER ${CMAKE_CURRENT_SOURCE_DIR}/src/tk_boot)
add_subdirectory_ifdef(CONFIG_TK_LOG ${CMAKE_CURRENT_SOURCE_DIR}/src/tk_log)

# add_executable(${ELF} ${STARTUP_FILE}
#   src/main.c
#   src/system_stm32g4xx.c)
  
# target_include_directories(${ELF} PUBLIC inc)

target_include_directories(${ELF} 
  PUBLIC
  src 
  src/app
  src/driver
  src/kernel
  src/service
  src/tool_chain
  stm32g4_ll/inc)

target_include_directories_ifdef(CONFIG_BOOTLOADER
  ${ELF} 
  PUBLIC
  ${CMAKE_CURRENT_SOURCE_DIR}/src/tk_boot
)

target_include_directories_ifdef(CONFIG_BOOT_F1
  ${ELF} 
  PUBLIC
  ${CMAKE_CURRENT_SOURCE_DIR}/src/tk_boot/boot_f1
)

target_include_directories_ifdef(CONFIG_BOOT_F2
  ${ELF} 
  PUBLIC
  ${CMAKE_CURRENT_SOURCE_DIR}/src/tk_boot/boot_f2
)

target_include_directories_ifdef(CONFIG_TK_LOG
  ${ELF} 
  PUBLIC
  ${CMAKE_CURRENT_SOURCE_DIR}/src/tk_log
)

target_link_libraries(${ELF} ll )

add_custom_command(
  TARGET ${ELF} POST_BUILD
  COMMAND ${CMAKE_OBJCOPY} -O ihex "${ELF}" "${PROJECT_NAME}.hex"
  COMMAND ${CMAKE_OBJCOPY} -O binary -S -g "${ELF}" "${PROJECT_NAME}.bin"
)


set_target_properties(
  ${ELF}
  PROPERTIES
  LINK_FLAGS
  "-T${PROJECT_SOURCE_DIR}/STM32G474RETX_FLASH.ld \
   -mthumb -mcpu=cortex-m4 \
   -Wl,--gc-sections \
   -Wl,--no-warn-rwx-segments \
   -Wl,-Map=${PROJECT_NAME}.map")

target_compile_options(${ELF} PUBLIC
  -Wall 
  -g 
  -std=gnu99 
  -Os
  -mthumb
  -mcpu=cortex-m4
  -mfloat-abi=soft
  -mlittle-endian
  -ffunction-sections 
  -fdata-sections
  -Werror 
  -Wstrict-prototypes 
  -Warray-bounds 
  -fno-strict-aliasing 
  -Wno-unused-const-variable 
  -specs=nano.specs 
  -specs=nosys.specs
  )

  # --no-warn-rwx-segments

file(COPY
  openocd.cfg
  DESTINATION
  ${CMAKE_BINARY_DIR})
```

## Kconfig
```
# Copyright (c) 2019 Intel Corporation
# SPDX-License-Identifier: Apache-2.0

source "src/tk_boot/Kconfig"
source "src/tk_log/Kconfig"


config DEPRECATED
	bool
	help
	  Symbol that must be selected by a feature or module if it is
	  considered to be deprecated.
	  
config WARN_DEPRECATED
	bool
	default y
	prompt "Warn on deprecated usage"
	help
	  Print a warning when the Kconfig tree is parsed if any deprecated
	  features are enabled.

config WARN_EXPERIMENTAL
	bool
	prompt "Warn on experimental usage"
	help
	  Print a warning when the Kconfig tree is parsed if any experimental
	  features are enabled.
```

## prj.conf
```kconfig
# nothing here
# CONFIG_TK_LOG=n

CONFIG_BOOTLOADER=y
CONFIG_BOOT_F1=y
CONFIG_BOOT_F2=n
CONFIG_TK_LOG=n
```

## src/main.c
```c
#include "main.h"
#include "led.h"

#include "test_boot.h"


int main(void)
{
  system_init();

  // usart2_init();

  // led_init();

  // CLI_INIT(CLI_BAUDRATE);


  while (1)
  {
      // LL_GPIO_TogglePin(GPIOC, LL_GPIO_PIN_13);
      // LL_mDelay(500);
      // LL_GPIO_TogglePin(GPIOA, LL_GPIO_PIN_5);
      led_task();
      test_boot_task();
  }
}
```

## src/main.h
```c
#ifndef MAIN_H
#define MAIN_H

#include "stm32g4xx_ll_bus.h"
#include "stm32g4xx_ll_rcc.h"
#include "stm32g4xx_ll_utils.h"
#include "stm32g4xx_ll_system.h"
#include "stm32g4xx_ll_utils.h"
#include "stm32g4xx_ll_gpio.h"
#include "stm32g4xx_ll_dma.h"
#include "stm32g4xx_ll_usart.h"

// #include "stm32g4xx_hal_rcc.h"
// #include "stm32g4xx_hal_rcc_ex.h"

#include "driver/drv_usart.h"

#include "init.h"
#include "led.h"


#endif
```
