## src/tk_boot/Kconfig
```kconfig
menuconfig BOOTLOADER
	bool "BOOTLOADER"
	help
	  Enable BOOTLOADER configuration.

if BOOTLOADER

config BOOT_F1
	bool "BOOT_F1"
    default n
	help
	  This option enables BOOT_F1.

config BOOT_F2
	bool "BOOT_F2"
    default n
	help
	  This option enables BOOT_F2.


module = BOOTLOADER
module-str = BOOTLOADER


endif # BOOTLOADER
```

## src/tk_log/Kconfig
```kconfig
menuconfig TK_LOG
	bool "TK_LOG"
	help
	  Enable TK_LOG configuration.

if TK_LOG

module = TK_LOG
module-str = TK_LOG


endif # TK_LOG
```
